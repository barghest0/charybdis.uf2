#include "charybdis.dtsi"

/ {
    chosen {
        // Dongle has no physical keys; scanning is mocked. The matrix
        // transform / physical layout come from charybdis.dtsi and map the
        // key events forwarded from the two peripheral halves.
        zmk,kscan = &mock_kscan;
    };

    mock_kscan: kscan_mock {
        compatible = "zmk,kscan-mock";
        columns = <0>;
        rows = <0>;
        events = <0>;
    };
};

// On the dongle kscan0 is inert (no compatible), so point the physical
// layout at the mock scanner instead — its kscan phandle must resolve to a
// real device. The matrix transform still maps the forwarded key events.
&physical_layout_0 {
    kscan = <&mock_kscan>;
};
